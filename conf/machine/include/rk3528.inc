## conf/machine/include/rk3528.inc
```bitbake
# Copyright (c) 2024 Radxa Computer (Shenzhen) Co., Ltd.
# Released under the MIT license (see COPYING.MIT for the terms)

require conf/machine/include/rockchip-arm64-common.inc

RK_SOC_FAMILY := "rk3528"

PREFERRED_VERSION_linux-rockchip := "6.1%"
LINUXLIBCVERSION := "6.1-custom%"
```

## conf/machine/radxa-zero-3e.conf
```bitbake
# Copyright (c) 2020, Rockchip Electronics Co., Ltd
# Released under the MIT license (see COPYING.MIT for the terms)

#@TYPE: Machine
#@NAME: RK3566 EVB

require conf/machine/include/rk3566.inc

KERNEL_DEVICETREE = "rockchip/rk3566-radxa-zero-3e.dtb"

UBOOT_MACHINE = "rk3568_defconfig"

MACHINE_EXTRA_RRECOMMENDS += "kernel-modules"
```
